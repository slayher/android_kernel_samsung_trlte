## arch/arm/configs/apq8084_sec_lentisqlte_eur_defconfig
```kconfig
# Lentisq PROJECT config
CONFIG_SEC_LENTISQ_PROJECT=y
CONFIG_MACH_LENTISQLTE_EUR=y
#
# MAX77803 IC
#
CONFIG_EXTCON=y
CONFIG_EXTCON_MAX77803=y
CONFIG_MFD_MAX77803=y
CONFIG_MOTOR_DRV_MAX77803=y
CONFIG_VIBETONZ=y
CONFIG_LEDS_MAX77803=y
#
# Battery & Charger
#
# CONFIG_SMB350_CHARGER is not set
# CONFIG_BATTERY_BQ28400 is not set
# CONFIG_BATTERY_MSM is not set
# CONFIG_FUELGAUGE_DUMMY is not set
#
# MAX77803 Charger
#
# CONFIG_QPNP_CHARGER is not set
# CONFIG_QPNP_BMS is not set
CONFIG_FUELGAUGE_MAX17048=y
CONFIG_CHARGER_MAX77803=y
CONFIG_BATTERY_SAMSUNG=y
CONFIG_SAMSUNG_LPM_MODE=y
#
#TSP
#
CONFIG_TOUCHSCREEN_SYNAPTICS_I2C_RMI=y
#
#TOUCHKEY
#
CONFIG_KEYBOARD_CYPRESS_TOUCHKEY_H=y
CONFIG_FB_MSM_MIPI_SAMSUNG_OCTA_CMD_FULL_HD_PT_PANEL=y
```
